## config/boards/arm/kbd533-lphs/Kconfig.board
```kconfig
# Copyright (c) 2021 Pavel Glushkov
# SPDX-License-Identifier: MIT

config BOARD_KBD533-LPHS_LEFT
	bool "kbd533-lphs_left"
	depends on SOC_NRF52833_QIAA

config BOARD_KBD533-LPHS_RIGHT
	bool "kbd533-lphs_right"
	depends on SOC_NRF52833_QIAA
```

## config/boards/arm/kbd533-lphs/Kconfig.defconfig
```kconfig
# Copyright (c) 2021 Pavel Glushkov
# SPDX-License-Identifier: MIT

if BOARD_KBD533-LPHS_LEFT

	config ZMK_KEYBOARD_NAME
	default "KBD533-LPHS"

    config ZMK_SPLIT_BLE_ROLE_CENTRAL
	default y

endif # BOARD_KBD533-LPHS_LEFT

if BOARD_KBD533-LPHS_RIGHT

	config ZMK_KEYBOARD_NAME
	default "KBD533-LPHS Right"

endif # BOARD_KBD533-LPHS_RIGHT


if BOARD_KBD533-LPHS_LEFT || BOARD_KBD533-LPHS_RIGHT

config BOARD
	default "kbd533-lphs"

config ZMK_SPLIT
	default y

config BT_CTLR
	default BT

config ZMK_BLE
	default y

config ZMK_USB
	default y

config ZMK_BATTERY_VOLTAGE_DIVIDER
	default y

if USB

config USB_NRFX
	default y

config USB_DEVICE_STACK
	default y

endif # USB

endif # BOARD_KBD533-LPHS_LEFT || BOARD_KBD533-LPHS_RIGHT
```

## config/boards/arm/kbd533/Kconfig.board
```kconfig
# Copyright (c) 2021 Pavel Glushkov
# SPDX-License-Identifier: MIT

config BOARD_KBD533_LEFT
	bool "kbd533_left"
	depends on SOC_NRF52833_QIAA

config BOARD_KBD533_RIGHT
	bool "kbd533_right"
	depends on SOC_NRF52833_QIAA
```

## config/boards/arm/kbd533/Kconfig.defconfig
```kconfig
# Copyright (c) 2021 Pavel Glushkov
# SPDX-License-Identifier: MIT

if BOARD_KBD533_LEFT

	config ZMK_KEYBOARD_NAME
	default "KBD533"

    config ZMK_SPLIT_BLE_ROLE_CENTRAL
	default y

endif # BOARD_KBD533_LEFT

if BOARD_KBD533_RIGHT

	config ZMK_KEYBOARD_NAME
	default "KBD533 Right"

endif # BOARD_KBD533_RIGHT


if BOARD_KBD533_LEFT || BOARD_KBD533_RIGHT

config BOARD
	default "kbd533"

config ZMK_SPLIT
	default y

config BT_CTLR
	default BT

config ZMK_BLE
	default y

config ZMK_USB
	default y

config ZMK_BATTERY_VOLTAGE_DIVIDER
	default y

if USB

config USB_NRFX
	default y

config USB_DEVICE_STACK
	default y

endif # USB

endif # BOARD_KBD533_LEFT || BOARD_KBD533_RIGHT
```

## config/boards/arm/kbd533/kbd533_left_defconfig
```kconfig
# SPDX-License-Identifier: MIT

CONFIG_ZMK_SPLIT_BLE_ROLE_CENTRAL=y

CONFIG_SOC_SERIES_NRF52X=y
CONFIG_SOC_NRF52833_QIAA=y
CONFIG_BOARD_KBD533_LEFT=y

CONFIG_ZMK_SPLIT=y
CONFIG_ZMK_SLEEP=y

CONFIG_ARM_MPU=y

CONFIG_GPIO=y

CONFIG_USE_DT_CODE_PARTITION=y
CONFIG_MPU_ALLOW_FLASH_WRITE=y
CONFIG_NVS=y
CONFIG_SETTINGS_NVS=y
CONFIG_FLASH=y
CONFIG_FLASH_PAGE_LAYOUT=y
CONFIG_FLASH_MAP=y

CONFIG_CLOCK_CONTROL_NRF=y
CONFIG_CLOCK_CONTROL_NRF_K32SRC_RC=y

# # Turn on logging, and set ZMK logging to debug output
CONFIG_ZMK_USB_LOGGING=y

# # Turn on logging, and set ZMK logging to debug output
# CONFIG_LOG=y
# CONFIG_ZMK_LOG_LEVEL_DBG=y
```

## config/boards/arm/kbd533/kbd533_right_defconfig
```kconfig
# SPDX-License-Identifier: MIT

CONFIG_SOC_SERIES_NRF52X=y
CONFIG_SOC_NRF52833_QIAA=y
BOARD_KBD533_RIGHT=y

CONFIG_ZMK_SPLIT=y
CONFIG_ZMK_SLEEP=y

CONFIG_ARM_MPU=y

CONFIG_GPIO=y

CONFIG_USE_DT_CODE_PARTITION=y
CONFIG_MPU_ALLOW_FLASH_WRITE=y
CONFIG_NVS=y
CONFIG_SETTINGS_NVS=y
CONFIG_FLASH=y
CONFIG_FLASH_PAGE_LAYOUT=y
CONFIG_FLASH_MAP=y

CONFIG_CLOCK_CONTROL_NRF_K32SRC_XTAL=y
CONFIG_CLOCK_CONTROL_NRF_K32SRC_30PPM=y

# # Turn on logging, and set ZMK logging to debug output
# CONFIG_ZMK_USB_LOGGING=y

# # Turn on logging, and set ZMK logging to debug output
# CONFIG_LOG=y
# CONFIG_ZMK_LOG_LEVEL_DBG=y
```
